## prototype/Config.in
```kconfig
source "$BR2_EXTERNAL_VELAOS_PATH/package/pgvector/Config.in"
source "$BR2_EXTERNAL_VELAOS_PATH/package/pgexporter/Config.in"
source "$BR2_EXTERNAL_VELAOS_PATH/package/su-exec/Config.in"
source "$BR2_EXTERNAL_VELAOS_PATH/package/vm-monitor/Config.in"
source "$BR2_EXTERNAL_VELAOS_PATH/package/neonvmd/Config.in"
source "$BR2_EXTERNAL_VELAOS_PATH/package/pgbouncer/Config.in"
source "$BR2_EXTERNAL_VELAOS_PATH/package/vector/Config.in"
source "$BR2_EXTERNAL_VELAOS_PATH/package/sb-storage/Config.in"
source "$BR2_EXTERNAL_VELAOS_PATH/package/pg-meta/Config.in"
source "$BR2_EXTERNAL_VELAOS_PATH/package/custom-postgis/Config.in"
source "$BR2_EXTERNAL_VELAOS_PATH/package/pgrouting/Config.in"
source "$BR2_EXTERNAL_VELAOS_PATH/package/h3/Config.in"
source "$BR2_EXTERNAL_VELAOS_PATH/package/postgresql-unit/Config.in"
source "$BR2_EXTERNAL_VELAOS_PATH/package/hypopg/Config.in"
source "$BR2_EXTERNAL_VELAOS_PATH/package/online-advisor/Config.in"
source "$BR2_EXTERNAL_VELAOS_PATH/package/hashids/Config.in"
source "$BR2_EXTERNAL_VELAOS_PATH/package/rum/Config.in"
source "$BR2_EXTERNAL_VELAOS_PATH/package/pgtap/Config.in"
source "$BR2_EXTERNAL_VELAOS_PATH/package/ip4r/Config.in"
source "$BR2_EXTERNAL_VELAOS_PATH/package/prefix/Config.in"
source "$BR2_EXTERNAL_VELAOS_PATH/package/postgresql-hll/Config.in"
source "$BR2_EXTERNAL_VELAOS_PATH/package/pg-ivm/Config.in"
source "$BR2_EXTERNAL_VELAOS_PATH/package/pg-cron/Config.in"
```

## prototype/configs/vela_qemu_x64_defconfig
```kconfig
BR2_x86_64=y
BR2_PACKAGE_HOST_LINUX_HEADERS_CUSTOM_6_12=y
BR2_TOOLCHAIN_BUILDROOT_CXX=y
# BR2_STRIP_strip is not set
BR2_GLOBAL_PATCH_DIR="$(BR2_EXTERNAL)/boards/common/patches $(BR2_EXTERNAL)/boards/qemu-common/patches $(BR2_EXTERNAL)/boards/vela-qemu-x64/patches"
BR2_DOWNLOAD_FORCE_CHECK_HASHES=y
BR2_ROOTFS_DEVICE_CREATION_DYNAMIC_EUDEV=y
BR2_SYSTEM_DHCP="eth0"
# BR2_ENABLE_LOCALE_PURGE is not set
BR2_SYSTEM_ENABLE_NLS=y
BR2_TARGET_TZ_INFO=y
BR2_ROOTFS_USERS_TABLES="$(BR2_EXTERNAL)/boards/common/user-table"
BR2_ROOTFS_OVERLAY="$(BR2_EXTERNAL)/boards/common/rootfs_overlay $(BR2_EXTERNAL)/boards/qemu-common/rootfs_overlay $(BR2_EXTERNAL)/boards/vela-qemu-x64/rootfs_overlay"
BR2_ROOTFS_POST_BUILD_SCRIPT="$(BR2_EXTERNAL)/boards/vela-qemu-x64/scripts/post-build.sh"
BR2_ROOTFS_POST_IMAGE_SCRIPT="$(BR2_EXTERNAL)/boards/vela-qemu-x64/scripts/post-image.sh"
BR2_ROOTFS_POST_SCRIPT_ARGS="$(BR2_DEFCONFIG)"
BR2_LINUX_KERNEL=y
BR2_LINUX_KERNEL_CUSTOM_VERSION=y
BR2_LINUX_KERNEL_CUSTOM_VERSION_VALUE="6.12.26"
BR2_LINUX_KERNEL_USE_CUSTOM_CONFIG=y
BR2_LINUX_KERNEL_CUSTOM_CONFIG_FILE="$(BR2_EXTERNAL)/boards/vela-qemu-x64/linux.config"
BR2_LINUX_KERNEL_NEEDS_HOST_LIBELF=y
BR2_PACKAGE_BUSYBOX_CONFIG="$(BR2_EXTERNAL)/boards/qemu-common/busybox.config"
BR2_PACKAGE_BUSYBOX_SHOW_OTHERS=y
BR2_PACKAGE_E2FSPROGS_RESIZE2FS=y
BR2_PACKAGE_E2TOOLS=y
BR2_PACKAGE_ACPID=y
BR2_PACKAGE_EUDEV_RULES_GEN=y
BR2_PACKAGE_NODEJS=y
BR2_PACKAGE_LIBYAML=y
BR2_PACKAGE_LIBCAP_TOOLS=y
BR2_PACKAGE_LIBCGROUP=y
BR2_PACKAGE_LIBCGROUP_TOOLS=y
BR2_PACKAGE_LINUX_PAM=y
BR2_PACKAGE_CHRONY=y
BR2_PACKAGE_OPENSSH=y
# BR2_PACKAGE_OPENSSH_CLIENT is not set
BR2_PACKAGE_FILE=y
BR2_PACKAGE_LOCKFILE_PROGS=y
BR2_PACKAGE_CGROUPFS_V2_MOUNT=y
BR2_PACKAGE_UTIL_LINUX_BINARIES=y
BR2_TARGET_ROOTFS_EXT2=y
BR2_TARGET_ROOTFS_EXT2_4=y
BR2_TARGET_ROOTFS_EXT2_LABEL="vmroot"
BR2_TARGET_ROOTFS_EXT2_SIZE="1G"
# BR2_TARGET_ROOTFS_TAR is not set
BR2_PACKAGE_HOST_GO=y
BR2_PACKAGE_HOST_QEMU_SYSTEM_MODE=y
BR2_PACKAGE_HOST_QEMU_VIRTFS=y
BR2_PACKAGE_POSTGRESQL_18=y
BR2_PACKAGE_POSTGRESQL_18_FULL=y
BR2_PACKAGE_PGVECTOR=y
BR2_PACKAGE_PGEXPORTER=y
BR2_PACKAGE_SU_EXEC=y
BR2_PACKAGE_VM_MONITOR=y
BR2_PACKAGE_NEONVMD=y
BR2_PACKAGE_PGBOUNCER=y
```

## prototype/package/custom-postgis/Config.in
```kconfig
config BR2_PACKAGE_CUSTOM_POSTGIS
	bool "custom-postgis"
	depends on BR2_PACKAGE_POSTGRESQL_18
	depends on BR2_INSTALL_LIBSTDCPP # libgeos, proj
	depends on BR2_TOOLCHAIN_GCC_AT_LEAST_7 # libgeos
	depends on BR2_TOOLCHAIN_HAS_THREADS_NPTL # proj
	depends on BR2_USE_WCHAR # libgeos, proj
	select BR2_PACKAGE_LIBGEOS
	select BR2_PACKAGE_PROJ
	select BR2_PACKAGE_LIBXML2
	select BR2_PACKAGE_LIBICONV if !BR2_ENABLE_LOCALE
	help
	  Postgis extension for PostgreSQL.
```

## prototype/package/h3/Config.in
```kconfig
config BR2_PACKAGE_H3
	bool "h3"
	depends on BR2_PACKAGE_POSTGRESQL_18
	depends on BR2_PACKAGE_CUSTOM_POSTGIS
	help
	  H3 Postgis extension for PostgreSQL.
```

## prototype/package/hashids/Config.in
```kconfig
config BR2_PACKAGE_HASHIDS
	bool "hashids"
	depends on BR2_PACKAGE_POSTGRESQL_18
	help
	  HashIds extension for PostgreSQL.
```

## prototype/package/hypopg/Config.in
```kconfig
config BR2_PACKAGE_HYPOPG
	bool "HypoPG"
	depends on BR2_PACKAGE_POSTGRESQL_18
	help
	  HypoPG extension for PostgreSQL.
```

## prototype/package/ip4r/Config.in
```kconfig
config BR2_PACKAGE_IP4R
	bool "ip4r"
	depends on BR2_PACKAGE_POSTGRESQL_18
	help
	  IP4R extension for PostgreSQL.
```

## prototype/package/online-advisor/Config.in
```kconfig
config BR2_PACKAGE_ONLINE_ADVISOR
	bool "online-advisor"
	depends on BR2_PACKAGE_POSTGRESQL_18
	help
	  Online Advisor extension for PostgreSQL.
```

## prototype/package/pgsodium/Config.in
```kconfig
config BR2_PACKAGE_PGSODIUM
	bool "pgsodium"
	depends on BR2_PACKAGE_POSTGRESQL
	select BR2_PACKAGE_LIBSODIUM
	help
	  pgsodium is an encryption library extension for PostgreSQL using the libsodium library for high level
	  cryptographic algorithms.
```

## prototype/package/pgtap/Config.in
```kconfig
config BR2_PACKAGE_PGTAP
	bool "pgtap"
	depends on BR2_PACKAGE_POSTGRESQL_18
	help
	  PG Tap extension for PostgreSQL.
```

## prototype/package/pgvector/Config.in
```kconfig
config BR2_PACKAGE_PGVECTOR
	bool "pgvector"
	depends on BR2_PACKAGE_POSTGRESQL_18
	help
	  PgVector extension for PostgreSQL.
```

## prototype/package/postgresql-hll/Config.in
```kconfig
config BR2_PACKAGE_POSTGRESQL_HLL
	bool "postgresql-hll"
	depends on BR2_PACKAGE_POSTGRESQL_18
	help
	  HyperLogLog extension for PostgreSQL.
```

## prototype/package/rum/Config.in
```kconfig
config BR2_PACKAGE_RUM
	bool "rum"
	depends on BR2_PACKAGE_POSTGRESQL_18
	help
	  RUM index extension for PostgreSQL.
```

## prototype/package/sb-storage/Config.in
```kconfig
config BR2_PACKAGE_SB_STORAGE
	bool "sb-storage"
	depends on BR2_PACKAGE_HAS_NODEJS
	select BR2_PACKAGE_NODEJS_SRC
	help
	  This is the Supabase-based storage service.
```

## prototype/package/systemd-exporter/Config.in
```kconfig
config BR2_SYSTEMD_PGBOUNCER_EXPORTER
	bool "systemd-exporter"
	help
	  Systemd Exporter for exporting system service status and metrics to Prometheus.
```
